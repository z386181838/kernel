## arch/arm/mach-mt7623/Kconfig
```kconfig
if ARCH_MT7623

menu "MT7623 Board Support Package"

choice
	bool "Board"

config MT7623_FPGA
	bool "MT7623 FPGA"
	select ARM_L1_CACHE_SHIFT_6
	help
	  Select if you are using the FPGA board.

config MT7623_EVB_BOARD
	bool "MT7623 EVB BOARD"
	select ARM_L1_CACHE_SHIFT_6
	help
	 Select if you are using an EVB board.

endchoice

config MT7623_FPGA_CA7
	tristate "MT7623 FPGA CA7" 
	depends on MT7623_FPGA
	default n
	help
	    Select if you are using the CA7 FPGA board.

config MAX_DRAM_SIZE_SUPPORT
	hex "The maximum size of the DRAM can be supported in the kernel"
	default 0x40000000
	depends on ARCH_MT7623
	help
		Define the maximum size of the kernel can be supported.
	        If will modify the memory size if it size is smaller than 
                the memory size passed by the boot loader to the MAX_DRAM_SIZE_SUPPORT.
   		Notice that the maximum DRAM size is including the memory size
	        reserved for the modem and the PMEM.

endmenu


endif
```

## drivers/misc/mediatek/Kconfig.met
```kconfig
config MET_MMC_PROFILE
	bool "Enable MET mmc profile"
	depends on MTK_MMC != n
	help
	  This is an option for use by developers; most people should
	  say N here.  This enables MET mmc profile index to profile mmc behavior.
```

## drivers/misc/mediatek/Kconfig.wcn
```kconfig
menu "WCN BU Module"

config  KERNEL_NVRAM
	bool 'Kernel NVRAM'
	default n

###########
# Debuging
###########
source "drivers/net/rt_rdm/Kconfig"

config MTK_ALPS_BOX_SUPPORT
	bool "MTK_ALPS_BOX_SUPPORT"

#############
# Wire
#############

source "drivers/net/raeth/Kconfig"

config  HW_IPSEC
	depends on ARCH_MT7623
	bool    "HW IPSec Enable"
	    select INET_AH
		select INET_ESP
		select INET_XFRM_MODE_TRANSPORT
		select INET_XFRM_MODE_TUNNEL
		select UNIX
		select XFRM
		select XFRM_USER
		select NET_KEY
		select CRYPTO_AEAD
		select CRYPTO_AUTHENC
		select CRTPTO_RNG
		select CRYPTO_CBC
		select CRYPTO_HMAC
		select CRYPTO_SHA1
		select CRYPTO_MD5
		select CRYPTO_AES
		select CRYPTO_DES
		select CRYPTO_ANSI_CPRNG
		default n

config  RALINK_HWCRYPTO
	depends on HW_IPSEC
	tristate "HW Crypto Engine"
	default m

#############
# Wireless
#############
menuconfig WIFI_DRIVER
	bool "WiFi Driver Support"

if WIFI_DRIVER

choice
	prompt "Choose First WiFi Interface"
	config FIRST_IF_NONE
	bool "None"

	config FIRST_IF_MT7610E
	bool "MT7610E"
	select RLT_MAC
	select RALINK_MT7610E
    
	config FIRST_IF_MT7612E
	bool "MT7612E"
	select RLT_MAC
	select RALINK_MT7612E

	config FIRST_IF_MT7602E
	bool "MT7602E"
	select RLT_MAC
	select RALINK_MT7602E

	config FIRST_IF_MT7603E
	bool "MT7603E"
	select MT_MAC
	select RALINK_MT7603E

	config FIRST_IF_MT7637E
	bool "MT7637E"
	select WIFI_MT_MAC
	select MT_MAC
	select RALINK_MT7637E

	config FIRST_IF_MT7615E
	bool "MT7615E"
	select WIFI_MT_MAC
	select MT_MAC
	select CHIP_MT7615E
endchoice

choice
	prompt "Choose Second WiFi Interface"
	config SECOND_IF_NONE
	bool "None"

	config SECOND_IF_MT7610U
	bool "MT7610U"
	select RLT_MAC
	select RALINK_MT7610U
    
	config SECOND_IF_MT7610E
	bool "MT7610E"
	select RLT_MAC
	select RALINK_MT7610E
    
	config SECOND_IF_MT7612U
	bool "MT7612U"
	select RLT_MAC
	select RALINK_MT7612U
    
	config SECOND_IF_MT7612E
	bool "MT7612E"
	select RLT_MAC
	select RALINK_MT7612E

	config SECOND_IF_MT7602E
	bool "MT7602E"
	select RLT_MAC
	select RALINK_MT7602E

	config SECOND_IF_MT7603E
	bool "MT7603E"
	select MT_MAC
	select RALINK_MT7603E

	config SECOND_IF_MT7637E
	bool "MT7637E"
	select WIFI_MT_MAC
	select MT_MAC
	select RALINK_MT7637E

	config SECOND_IF_MT7615E
	bool "MT7615E"
	select WIFI_MT_MAC
	select CHIP_MT7615E
endchoice

choice
	prompt "Choose Third WiFi Interface"
	config THIRD_IF_NONE
	bool "None"

	config THIRD_IF_MT7615E
	bool "MT7615E"
	select WIFI_MT_MAC
	select MT_MAC
	select CHIP_MT7615E
endchoice

config  RT_FIRST_CARD
        string
        depends on ! FIRST_IF_NONE
	default 7610e if FIRST_IF_MT7610E
	default 7612e if FIRST_IF_MT7612E
	default 7602e if FIRST_IF_MT7602E
	default 7603e if FIRST_IF_MT7603E
	default 7637e if FIRST_IF_MT7637E
	default 7615e if FIRST_IF_MT7615E
        
config  RT_SECOND_CARD
        string
        depends on ! SECOND_IF_NONE
        default 7610e if SECOND_IF_MT7610E
        default 7610u if SECOND_IF_MT7610U
	default 7612e if SECOND_IF_MT7612E
	default 7612u if SECOND_IF_MT7612U
	default 7602e if SECOND_IF_MT7602E
	default 7603e if SECOND_IF_MT7603E
	default 7637e if SECOND_IF_MT7637E
	default 7615e if SECOND_IF_MT7615E

config  RT_THIRD_CARD
	string
	depends on ! THIRD_IF_NONE
	default 7615e if THIRD_IF_MT7615E
        
config  RT_FIRST_IF_RF_OFFSET
        hex
        depends on ! FIRST_IF_NONE
        default 0x0

config  RT_SECOND_IF_RF_OFFSET
        hex
        depends on ! SECOND_IF_NONE
        default 0x8000

config  RT_THIRD_IF_RF_OFFSET
	hex
	depends on ! THIRD_IF_NONE
	default 0x4000

source "drivers/net/wireless/rlt_wifi/Kconfig"
source "drivers/net/wireless/mt_wifi/embedded/Kconfig"

endif # WIFI_DRIVER


config RTDEV
	bool
	default y if WIFI_DRIVER && !SECOND_IF_NONE || RTDEV_MII
	default y if RTDEV_PLC

#######
# USB
#######

#######
# NAT
#######
choice
prompt "NAT Type"
	
config  RA_NAT_NONE
bool "None"
config  RA_NAT_HW
bool "Hardware"
endchoice

source "net/nat/hw_nat/Kconfig"


endmenu
```

## drivers/misc/mediatek/lcm/Kconfig
```kconfig
#
#  Mediatek LCM driver support list
#

menu "Mediatek LCM driver support"

config NT35517_QHD_DSI_VIDEO
	bool "Support for LCM nt35517_qhd_dsi_video"
	default n
	help
	    Select this if you are using "nt35517_qhd_dsi_video"
config CM_N070ICE_DSI_VDO
	bool "Support for LCM cm_n070ice_dsi_vdo"
	default n
	help
	    Select this if you are using "cm_n070ice_dsi_vdo"

config CM_N070ICE_DSI_VDO_MT8135
	bool "Support for LCM cm_n070ice_dsi_vdo_mt8135"
	default n
	help
	    Select this if you are using "cm_n070ice_dsi_vdo_mt8135"
			To config mt8135_evbp1_v2 lcm driver. If choose yes
			cm_n070ice_dsi_vdo_mt8135 lcm driver will be used
			This add for half display issue

config HSD070PFW3_8135
	bool "Support for LCM HSD070PFW3_8135"
	default n
	help
	    Select this if you are using "HSD070PFW3_8135"

config CPT_CLAA101FP01_DSI_VDO
	bool "Support for LCM CPT_CLAA101FP01_DSI_VDO"
	default n
	help
	    Select this if you are using "CPT_CLAA101FP01_DSI_VDO"

config NT35521_WXGA_DSI_VDO_HH060IA
	bool "Support for LCM nt35521_wxga_dsi_vdo_hh060ia"
	default n
	help
	    Select this if you are using "nt35521_wxga_dsi_vdo_hh060ia"

config NT51012_WXGA_DSI_VDO
	bool "Support for LCM nt51012_wxga_dsi_vdo"
	default n
	help
	    Select this if you are using "nt51012_wxga_dsi_vdo"

config CPT_CLAP070WP03XG_SN65DSI83
	bool "Support for LCM cpt_clap070wp03xg_sn65dsi83"
	default n
	help
	    Select this if you are using "cpt_clap070wp03xg_sn65dsi83"
			To config mt6595_tablet_p1v1 lcm driver. If choose yes
			cpt_clap070wp03xg_sn65dsi83 lcm driver will be used
			This add for half display issue

config CPT_CLAP070WP03XG_LVDS
	bool "Support for LCM cpt_clap070wp03xg_lvds"
	default n
	help
	    Select this if you are using "cpt_clap070wp03xg_lvds"

config NT35590_HD720_DSI_CMD_AUO
	bool "Support for LCM nt35590_hd720_dsi_cmd_auo_lcm"
	default n
	help
	    Select this if you are using "nt35590_hd720_dsi_cmd_auo"
	    
config HX8392A_DSI_CMD
	bool "Support for LCM hx8392a_dsi_cmd"
	default n
	help
	    Select this if you are using "hx8392a_dsi_cmd"
	    
config HX8392A_DSI_VDO
	bool "Support for LCM hx8392a_dsi_vdo"
	default n
	help
	    Select this if you are using "hx8392a_dsi_vdo"	    
endmenu
```

## drivers/net/wireless/mt_soc/Kconfig
```kconfig
menu "MediaTek WLAN Config"

config MTK_CONNSYS_WIFI
	tristate "MediaTek Soc Wi-Fi support"
	depends on MTK_COMBO
	depends on MMC
	depends on IPV6
	depends on !mt592x
	select WIRELESS_EXT
	select WEXT_PRIV
	select MTK_WLAN_SUPPORT
	help
	  This module adds support for wireless adapters based on
	  MTK Soc chipset.

	  This driver uses the kernel's wireless extensions subsystem.

	  If you choose to build a module, it'll be called dhd. Say M if
	  unsure.

config MTK_WLAN_CHIP
	string "MTK_WLAN_CHIP"
	default "CONSYS" if MTK_CONNSYS_WIFI
	help
	   Define the wlan chip type

config MTK_WLAN_SUPPORT
	bool
	help
	   The Wlan switch for the wlan feature in the Android(app,
	   framework, native, kernel).

config MTK_WAPI_SUPPORT
	bool "MTK_WAPI_SUPPORT"
	help
	   if it is set to TRUE: Support WAPI (WLAN Authentication and
	   Privacy Infrastructure) if it is set to FALSE: Does not Support
	   WAPI (WLAN Authentication and Privacy Infrastructure)

endmenu
```

## drivers/usb/mu3h/Kconfig
```kconfig
config USB_MU3H
	tristate "MU3H (MTK USB3.0 Host) Controller"
	depends on USB

	  
choice 
	depends on USB_MU3H
	bool "MTK USB3.0 Host Drivers"
	default USB_MU3H_DRV
	
config USB_MU3H_DRV
	bool "MU3H Driver: default support USB port0"
config USB_MU3H_TEST_DRV
	bool "MU3H Test Driver"
	
endchoice

config MULTIPLE_MU3H_PORT
	depends on USB_MU3H_DRV
       	depends on ARCH_MT7623
	bool "Support USB port1"
	default y

config XHCI_DEV_NOTE
    tristate "xHCI HCD with device notification function (patch to usb core)"
    depends on USB_MU3H
config XHCI_PM
    tristate "xHCI HCD with u2/u3 LPM function (patch to usb core)"
    depends on USB_MU3H
config USB_XHCI_DEBUGGING
    bool "Debugging for xHCI host controller"
    depends on USB_MU3H
```

## sound/soc/mediatek/Kconfig
```kconfig
menuconfig SND_SOC_MT8135
    bool "SoC Audio support for MT8135"
    depends on ARCH_MT8135
    help
        If you say Y, enable SND_SOC_MT8135.

config SND_SOC_MT6595
    bool "SND_SOC_MT6595"
    depends on ARCH_MT6595
    default y
    help
        If you say Y, enable SND_SOC_MT6595 driver.

config MTK_SPEAKER
    bool "MTK_SPEAKER"
    depends on ARCH_MT6595
    default y
    help
        If you say Y, enable MTK_SPEAKER_AMP
        
config SND_SOC_MT8127
    tristate "SoC Audio for MediaTek MT8127"
    depends on ARCH_MT8127
    default n
    help
        Say Y if you want to add support for SoC audio on the MediaTek MT8127 platform.

config SND_SOC_MT7623
    bool "SoC Audio support for MT7623"
    depends on ARCH_MT7623
    help
        If you say Y, enable SND_SOC_MT7623.
```
